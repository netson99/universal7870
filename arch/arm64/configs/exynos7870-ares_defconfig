## arch/arm64/configs/exynos7870-ares_defconfig
```kconfig
#
#
# AresKernel
#
# CONFIG_HOTPLUG_CPU is not set
# CONFIG_EXYNOS_HOTPLUG_GOVERNOR is not set
```

## arch/arm64/hotplug/AUTOSMP/Kconfig
```kconfig
config ASMP
    bool "Multi-core automatic hotplug support"
    depends on HOTPLUG_CPU
    default n
    help
      Automatically hotplugs the multiple cpu cores on and off
      based on cpu load and suspend state.
```
